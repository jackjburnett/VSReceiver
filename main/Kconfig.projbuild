## main/Kconfig.projbuild
```kconfig
menu "VSLink receiver"
choice VSLINK_USB_MODE
    prompt "USB gamepad identity"
    default VSLINK_USB_XINPUT
config VSLINK_USB_XINPUT
    bool "Xbox 360 XInput (private testing)"
config VSLINK_USB_HID
    bool "Generic HID gamepad"
endchoice
config VSLINK_QUEUE_DEPTH
    int "Queued commands"
    range 4 256
    default 64
config VSLINK_HID_VID
    hex "HID VID (replace with your assigned ID for distribution)"
    default 0xCAFE
config VSLINK_HID_PID
    hex "HID PID (development only)"
    default 0x4010
endmenu
```

## sdkconfig.defaults
```kconfig
CONFIG_IDF_TARGET="esp32s3"
CONFIG_BT_ENABLED=y
CONFIG_BT_NIMBLE_ENABLED=y
CONFIG_BT_BLUEDROID_ENABLED=n
CONFIG_BT_NIMBLE_ROLE_CENTRAL=n
CONFIG_BT_NIMBLE_ROLE_OBSERVER=n
CONFIG_BT_NIMBLE_MAX_CONNECTIONS=1
CONFIG_BT_NIMBLE_ATT_PREFERRED_MTU=517
CONFIG_ESP_CONSOLE_UART_DEFAULT=y
CONFIG_ESP_CONSOLE_SECONDARY_NONE=y
CONFIG_ESP_MAIN_TASK_STACK_SIZE=8192
CONFIG_FREERTOS_HZ=1000
CONFIG_TINYUSB_CDC_ENABLED=n
CONFIG_TINYUSB_CDC_COUNT=0
CONFIG_TINYUSB_HID_COUNT=0
CONFIG_LOG_DEFAULT_LEVEL_WARN=y
CONFIG_COMPILER_CXX_EXCEPTIONS=y
```
